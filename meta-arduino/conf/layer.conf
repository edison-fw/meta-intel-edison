## meta-arduino/conf/layer.conf
```bitbake
# We have a conf and classes directory, add to BBPATH
BBPATH .= ":${LAYERDIR}"

# We have recipes-* directories, add to BBFILES
BBFILES += "${LAYERDIR}/recipes-*/*/*.bb \
	${LAYERDIR}/recipes-*/*/*.bbappend"

BBFILE_COLLECTIONS += "galileo"
BBFILE_PATTERN_galileo = "^${LAYERDIR}/"
BBFILE_PRIORITY_galileo = "6"

PREFERRED_VERSION_uclibc = "0_9_33"
PREFERRED_VERSION_uclibc-initial = "0_9_33"
```

## meta-edison-arduino/conf/layer.conf
```bitbake
# We have a conf and classes directory, add to BBPATH
BBPATH := "${BBPATH}:${LAYERDIR}"

# We have a recipes-* directories, add to BBFILES
BBFILES := "${BBFILES} ${LAYERDIR}/recipes-*/*/*.bb \
	${LAYERDIR}/recipes-*/*/*.bbappend"

BBFILE_COLLECTIONS += "edison-arduino"
BBFILE_PATTERN_edison-arduino = "^${LAYERDIR}/"
BBFILE_PRIORITY_edison-arduino = "6"
```

## meta-edison-distro/conf/distro/poky-edison.conf
```bitbake
require conf/distro/poky.conf
DISTRO = "poky-edison"

PREFERRED_PROVIDER_virtual/kernel ?= "linux-yocto"
PREFERRED_VERSION_linux-yocto = "3.10%"
PREFERRED_PROVIDER_virtual/bootloader ?=  "u-boot"
PREFERRED_VERSION_u-boot ?= "2014.04-1"
PREFERRED_VERSION_u-boot-fw-utils ?= "2014.04-1"
PREFERRED_VERSION_connman ?= "1.27"
PREFERRED_VERSION_openssl ?= "1.0.1j"
PREFERRED_VERSION_systemd ?= "213+gitAUTOINC+c9679c652b"

DISTRO_FEATURES = "systemd alsa argp bluetooth ext2 largefile usbgadget usbhost wifi xattr nfs zeroconf pci ${DISTRO_FEATURES_LIBC}"

# Disable sysvinit for recipes with systemd support
DISTRO_FEATURES_BACKFILL_CONSIDERED += "sysvinit"
VIRTUAL-RUNTIME_initscripts = ""
VIRTUAL-RUNTIME_init_manager = "systemd"
# Uncomment to completely disable support for sysv scripts:
PACKAGECONFIG_pn-systemd = "xz"
```

## meta-edison-distro/conf/layer.conf
```bitbake
# We have a conf and classes directory, add to BBPATH
BBPATH := "${BBPATH}:${LAYERDIR}"

# We have a recipes-* directories, add to BBFILES
BBFILES := "${BBFILES} ${LAYERDIR}/recipes-*/*/*.bb \
	${LAYERDIR}/recipes-*/*/*.bbappend"

BBFILE_COLLECTIONS += "edison-distro"
BBFILE_PATTERN_edison-distro = "^${LAYERDIR}/"
BBFILE_PRIORITY_edison-distro = "6"
```

## meta-edison-middleware/conf/layer.conf
```bitbake
# We have a conf and classes directory, add to BBPATH
BBPATH := "${BBPATH}:${LAYERDIR}"

# We have a recipes-* directories, add to BBFILES
BBFILES := "${BBFILES} ${LAYERDIR}/recipes-*/*/*.bb \
	${LAYERDIR}/recipes-*/*/*.bbappend"

BBFILE_COLLECTIONS += "edison-middleware"
BBFILE_PATTERN_edison-middleware = "^${LAYERDIR}/"
BBFILE_PRIORITY_edison-middleware = "6"

PREFERRED_VERSION_nodejs = "0.10.28"
PREFERRED_VERSION_nodejs-native = "0.10.28"
```

## meta-edison/conf/machine/edison.conf
```bitbake
#@TYPE: Machine
#@NAME: edison

#@DESCRIPTION: Machine configuration for edison systems

# This sets compilation options close to what is used on android
include conf/machine/include/tune-atom.inc
TUNE_CCARGS .= " -mstackrealign -fno-omit-frame-pointer"

MACHINE_FEATURES = "bluetooth alsa pci serial usbgadget usbhost wifi x86 ext3"
KERNEL_IMAGETYPE = "bzImage"
SERIAL_CONSOLES = "115200;ttyMFD2"
UBOOT_MACHINE = "edison_config"

module_autoload_bcm_bt_lpm = "bcm_bt_lpm"
module_autoload_bcm4334x = "bcm4334x"
module_conf_bcm4334x = "options bcm4334x firmware_path=/etc/firmware/fw_bcmdhd.bin nvram_path=/etc/firmware/bcmdhd.cal op_mode=4"
module_autoload_g_multi = "g_multi"
# FIXME: file parameter should be based on partition UUID (from U-Boot) or fixed
# with label (label seems to work, but driver is probed too early)
module_conf_g_multi = "options g_multi file=/dev/mmcblk0p9 stall=0 idVendor=0x8087 idProduct=0x0A9E iProduct=Edison iManufacturer=Intel"
```

## meta-intel-arduino/conf/layer.conf
```bitbake
# We have a conf and classes directory, add to BBPATH
BBPATH := "${BBPATH}:${LAYERDIR}"

# We have a recipes-* directories, add to BBFILES
BBFILES := "${BBFILES} ${LAYERDIR}/recipes-*/*/*.bb \
	${LAYERDIR}/recipes-*/*/*.bbappend"

BBFILE_COLLECTIONS += "intel-arduino"
BBFILE_PATTERN_intel-arduino = "^${LAYERDIR}/"
BBFILE_PRIORITY_intel-arduino = "6"
```

## meta-intel-edison-bsp/conf/layer.conf
```bitbake
# We have a conf and classes directory, add to BBPATH
BBPATH := "${BBPATH}:${LAYERDIR}"

# We have a recipes-* directories, add to BBFILES
BBFILES := "${BBFILES} ${LAYERDIR}/recipes-*/*/*.bb \
	${LAYERDIR}/recipes-*/*/*.bbappend"

BBFILE_COLLECTIONS += "intel-edison-bsp"
BBFILE_PATTERN_intel-edison-bsp = "^${LAYERDIR}/"
BBFILE_PRIORITY_intel-edison-bsp = "6"

LAYERSERIES_COMPAT_intel-edison-bsp = "rocko sumo thud"
```

## meta-intel-edison-bsp/conf/machine/edison.conf
```bitbake
#@TYPE: Machine
#@NAME: edison

#@DESCRIPTION: Machine configuration for edison systems

# Here you can set compilation options if needed
include conf/machine/include/x86/tune-corei7.inc
#TUNE_CCARGS .= " -mstackrealign"
DEFAULTTUNE = "corei7-32"

MACHINE_FEATURES = "bluetooth alsa pci serial usbgadget usbhost wifi x86 ext3"
KERNEL_IMAGETYPE = "bzImage"
INITRAMFS_MAXSIZE ="15728640"
INITRAMFS_FSTYPES = "cpio.gz"
SERIAL_CONSOLES = "115200;ttyS2"
UBOOT_MACHINE = "edison_defconfig"

# this tells yocto to use the defconfig supplied with the kernel
#KBUILD_DEFCONFIG="x86_64_defconfig"
KBUILD_DEFCONFIG="i386_defconfig"
# this tells yocto to expand the defconfig, i.e. make defconfig
KCONFIG_MODE="--alldefconfig"

KERNEL_MODULE_AUTOLOAD += " ledtrig-heartbeat ledtrig-timer tun"

ACPI_TABLES ?= "arduino-leds-ds2.asl"
ACPI_FEATURES:edison ?= "uart_2w i2c"
```

## meta-intel-edison-devenv/conf/layer.conf
```bitbake
# We have a conf and classes directory, add to BBPATH
BBPATH := "${BBPATH}:${LAYERDIR}"

# We have a recipes-* directories, add to BBFILES
BBFILES := "${BBFILES} ${LAYERDIR}/recipes-*/*/*.bb \
	${LAYERDIR}/recipes-*/*/*.bbappend"

BBFILE_COLLECTIONS += "intel-edison-devenv"
BBFILE_PATTERN_intel-edison-devenv = "^${LAYERDIR}/"
BBFILE_PRIORITY_intel-edison-devenv = "6"

PREFERRED_PROVIDER_virtual/kernel = "linux-externalsrc"
PREFERRED_VERSION_linux-externalsrc = "1.0"
```

## meta-intel-edison-devtools/conf/layer.conf
```bitbake
# We have a conf and classes directory, add to BBPATH
BBPATH := "${BBPATH}:${LAYERDIR}"

# We have a recipes-* directories, add to BBFILES
BBFILES := "${BBFILES} ${LAYERDIR}/recipes-*/*/*.bb \
	${LAYERDIR}/recipes-*/*/*.bbappend"

BBFILE_COLLECTIONS += "intel-edison-devtools"
BBFILE_PATTERN_intel-edison-devtools = "^${LAYERDIR}/"
BBFILE_PRIORITY_intel-edison-devtools = "6"
```

## meta-intel-edison-distro/conf/layer.conf
```bitbake
# We have a conf and classes directory, add to BBPATH
BBPATH := "${BBPATH}:${LAYERDIR}"

# We have a recipes-* directories, add to BBFILES
BBFILES := "${BBFILES} ${LAYERDIR}/recipes-*/*/*.bb \
	${LAYERDIR}/recipes-*/*/*.bbappend"

BBFILE_COLLECTIONS += "intel-edison-distro"
BBFILE_PATTERN_intel-edison-distro = "^${LAYERDIR}/"
BBFILE_PRIORITY_intel-edison-distro = "6"

LAYERSERIES_COMPAT_intel-edison-distro = "rocko sumo thud"
```

## meta-intel-iot-middleware/conf/layer.conf
```bitbake
# We have a conf and classes directory, add to BBPATH
BBPATH := "${BBPATH}:${LAYERDIR}"

# We have a recipes-* directories, add to BBFILES
BBFILES := "${BBFILES} ${LAYERDIR}/recipes-*/*/*.bb \
	${LAYERDIR}/recipes-*/*/*.bbappend"

BBFILE_COLLECTIONS += "intel-iot-middleware"
BBFILE_PATTERN_intel-iot-middleware = "^${LAYERDIR}/"
BBFILE_PRIORITY_intel-iot-middleware = "6"

PREFERRED_VERSION_nodejs = "0.10.35"
PREFERRED_VERSION_nodejs-native = "0.10.35"
```

## meta-xfstk/conf/layer.conf
```bitbake
# We have a conf and classes directory, add to BBPATH
BBPATH := "${BBPATH}:${LAYERDIR}"

# We have a recipes-* directories, add to BBFILES
BBFILES := "${BBFILES} ${LAYERDIR}/recipes-*/*/*.bb \
	${LAYERDIR}/recipes-*/*/*.bbappend"

BBFILE_COLLECTIONS += "xfstk"
BBFILE_PATTERN_xfstk = "^${LAYERDIR}/"
BBFILE_PRIORITY_xfstk = "10"

LAYERSERIES_COMPAT_xfstk = "rocko sumo thud warrior zeus"
```
